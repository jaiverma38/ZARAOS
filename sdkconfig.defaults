## sdkconfig.defaults
```kconfig
CONFIG_IDF_TARGET="esp32s3"
CONFIG_ESPTOOLPY_FLASHSIZE_16MB=y
CONFIG_SPIRAM=y
CONFIG_SPIRAM_MODE_OCT=y
CONFIG_SPIRAM_SPEED_80M=y
CONFIG_FREERTOS_HZ=1000
CONFIG_PARTITION_TABLE_CUSTOM=y
CONFIG_PARTITION_TABLE_CUSTOM_FILENAME="partitions/zaraos.csv"
CONFIG_MBEDTLS_CERTIFICATE_BUNDLE=y
CONFIG_ESP_HTTPS_OTA_ALLOW_HTTP=n
CONFIG_NVS_ENCRYPTION=y
CONFIG_ESP_TASK_WDT_EN=y
CONFIG_LITTLEFS_PAGE_SIZE=256
CONFIG_LITTLEFS_OBJ_NAME_LEN=64
```
